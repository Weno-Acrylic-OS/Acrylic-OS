## x86_os/configs/weno_defconfig
```kconfig
#
# Acrylic OS - AArch64 Kiosk Defconfig
#

# --- System Configuration
BR2_aarch64=y
BR2_TARGET_GENERIC_GETTY_PORT="ttyAMA0"
BR2_ROOTFS_DEVICE_CREATION_DYNAMIC_EUDEV=y
BR2_SYSTEM_DHCP="eth0"

# --- Toolchain (Optimized for space)
BR2_TOOLCHAIN_EXTERNAL=y
BR2_TOOLCHAIN_EXTERNAL_BOOTLIN=y
BR2_TOOLCHAIN_EXTERNAL_BOOTLIN_AARCH64_GLIBC_STABLE=y

# --- Build options (Optimized for space)
BR2_DELETED_TMPDIR=y

# --- Kernel
BR2_LINUX_KERNEL=y
BR2_LINUX_KERNEL_CUSTOM_VERSION=y
BR2_LINUX_KERNEL_CUSTOM_VERSION_VALUE="6.1.76"
# Use a generic ARM64 defconfig
BR2_LINUX_KERNEL_USE_ARCH_DEFAULT_CONFIG=y
BR2_LINUX_KERNEL_CONFIG_FRAGMENT_FILES=""

# --- Filesystem / Image (CORRECTED FOR BUILDROOT 2023.11)
BR2_TARGET_ROOTFS_EXT2=y
BR2_TARGET_ROOTFS_EXT2_4=y
BR2_TARGET_ROOTFS_EXT2_SIZE="512M"

# Disk image assembly via genimage (post-image hook)
BR2_PACKAGE_HOST_GENIMAGE=y
BR2_ROOTFS_POST_IMAGE_SCRIPT="$(BR2_EXTERNAL_WENO_X86_PATH)/board/weno-arm64/post-image.sh"

# Bootloader setup
BR2_TARGET_GRUB2=y
BR2_TARGET_GRUB2_ARM64_EFI=y
BR2_LINUX_KERNEL_INSTALL_TARGET=y

# --- Target Packages
BR2_PACKAGE_BUSYBOX_SHOW_OTHERS=y

# --- Graphics and UI
BR2_PACKAGE_XORG_SERVER=y
BR2_PACKAGE_XORG7_XAPP_XINIT=y
BR2_PACKAGE_FLUXBOX=y
BR2_PACKAGE_WEBKITGTK=y
BR2_PACKAGE_SURF=y

# --- Fonts (required by browser)
BR2_PACKAGE_FONT_AWESOME=y
BR2_PACKAGE_LIBERATION=y

# --- Custom Overlay
BR2_ROOTFS_OVERLAY="$(BR2_EXTERNAL_WENO_X86_PATH)/overlay"
BR2_PACKAGE_PYTHON3=y
BR2_PACKAGE_HOST_FLASK=y
BR2_PACKAGE_PYTHON_FLASK=y
BR2_PACKAGE_PYTHON_PILLOW=y

# --- Update Client ---
BR2_PACKAGE_RAUC=y
BR2_PACKAGE_DBUS=y
BR2_PACKAGE_PYTHON_DBUS_PYTHON=y

# --- Fix for missing packages ---
BR2_PACKAGE_XORG_UTILS=y
BR2_PACKAGE_PYTHON_FLASK_CORS=y
BR2_PACKAGE_PYTHON_DBUS_PYTHON=y
```
